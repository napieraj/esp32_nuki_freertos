/*
 * Host unit test for components/nuki_uart_bridge/nuki_uart_seclink.{h,cpp}.
 *
 * Build & run:  make test-seclink
 *           or: g++ -std=c++17 -Wall -Wextra -Werror \
 *                   -Icomponents/nuki_uart_bridge \
 *                   tests/test_seclink_host.cpp \
 *                   components/nuki_uart_bridge/nuki_uart_seclink.cpp \
 *                   $(pkg-config --cflags --libs libsodium) -o t && ./t
 *
 * What is pinned here is the bridge's deterministic transcript
 * (nRF52840_nuki_bridge/tests/sec_link_vectors.txt, generated by its
 * tests/test_sec_link.c with Monocypher).  The ESP32 plays the INITIATOR:
 * from the host seeds it must produce the identical PAIR and HS_INIT bytes,
 * accept the bridge's HS_RESP, and seal / open the first DATA frame in each
 * direction byte for byte.  The RESPONDER path is exercised too so the DH
 * slot ordering is verified from both ends in one process.
 *
 * Primitive KATs come first: if they pass, libsodium agrees with RFC 7748 /
 * RFC 7693 / draft-irtf-cfrg-xchacha, and a transcript mismatch is a
 * protocol bug rather than a crypto-library one.
 *
 * Set SEC_LINK_VECTORS=/path/to/sec_link_vectors.txt to additionally check
 * that file against the pinned constants (catches a regenerated transcript).
 */

#include "nuki_uart_seclink.h"

#include <sodium.h>

#include <cstdio>
#include <cstdlib>
#include <cstring>
#include <string>

static int checks;
static int failures;

#define CHECK(cond)                                                            \
  do {                                                                         \
    checks++;                                                                  \
    if (!(cond)) {                                                             \
      failures++;                                                              \
      printf("FAIL %s:%d: %s\n", __FILE__, __LINE__, #cond);                   \
    }                                                                          \
  } while (0)

static void hexdump(const char *label, const uint8_t *p, size_t n) {
  printf("%-16s", label);
  for (size_t i = 0; i < n; i++) {
    printf("%02X", p[i]);
  }
  printf("\n");
}

#define CHECK_MEM(got, exp, n)                                                 \
  do {                                                                         \
    checks++;                                                                  \
    if (memcmp((got), (exp), (n)) != 0) {                                      \
      failures++;                                                              \
      printf("FAIL %s:%d: %s != %s (%u bytes)\n", __FILE__, __LINE__, #got,    \
             #exp, (unsigned)(n));                                             \
      hexdump("  got", (got), (n));                                            \
      hexdump("  want", (exp), (n));                                           \
    }                                                                          \
  } while (0)

static int nibble(char c) {
  if (c >= '0' && c <= '9') {
    return c - '0';
  }
  if (c >= 'a' && c <= 'f') {
    return c - 'a' + 10;
  }
  if (c >= 'A' && c <= 'F') {
    return c - 'A' + 10;
  }
  return -1;
}

/* Hex -> bytes; whitespace ignored; aborts on a typo (a bad vector must not
 * pass). */
static size_t unhex(uint8_t *out, size_t out_max, const char *hex) {
  size_t n = 0;
  int hi = -1;
  for (const char *p = hex; *p != '\0'; p++) {
    if (*p == ' ' || *p == '\n' || *p == '\t' || *p == '\r') {
      continue;
    }
    int v = nibble(*p);
    if (v < 0) {
      printf("bad hex digit '%c'\n", *p);
      exit(2);
    }
    if (hi < 0) {
      hi = v;
      continue;
    }
    if (n >= out_max) {
      printf("hex too long for %u-byte buffer\n", (unsigned)out_max);
      exit(2);
    }
    out[n++] = (uint8_t)((hi << 4) | v);
    hi = -1;
  }
  if (hi >= 0) {
    printf("odd hex length\n");
    exit(2);
  }
  return n;
}

/* ── Pinned transcript (sec_link_vectors.txt) ────────────────────────── */

struct Vector {
  const char *label;
  const char *hex;
};

static const Vector VECTORS[] = {
    {"host_seed",
     "000102030405060708090A0B0C0D0E0F101112131415161718191A1B1C1D1E1F"},
    {"host_pk",
     "8F40C5ADB68F25624AE5B214EA767A6EC94D829D3D7B5E1AD1BA6F3E2138285F"},
    {"bridge_seed",
     "202122232425262728292A2B2C2D2E2F303132333435363738393A3B3C3D3E3F"},
    {"bridge_pk",
     "358072D6365880D1AEEA329ADF9121383851ED21A28E3B75E965D0D2CD166254"},
    {"host_eph_seed",
     "404142434445464748494A4B4C4D4E4F505152535455565758595A5B5C5D5E5F"},
    {"bridge_eph_seed",
     "606162636465666768696A6B6C6D6E6F707172737475767778797A7B7C7D7E7F"},
    {"host_eph_pk",
     "79A631EEDE1BF9C98F12032CDEADD0E7A079398FC786B88CC846EC89AF85A51A"},
    {"bridge_eph_pk",
     "675DD574ED7789310B3D2E7681F3790B466C773B1521FECF36577958371EA52F"},
    {"PAIR_host",
     "E38F40C5ADB68F25624AE5B214EA767A6EC94D829D3D7B5E1AD1BA6F3E2138285F"},
    {"PAIR_bridge",
     "E3358072D6365880D1AEEA329ADF9121383851ED21A28E3B75E965D0D2CD166254"},
    {"HS_INIT",
     "E179A631EEDE1BF9C98F12032CDEADD0E7A079398FC786B88CC846EC89AF85A51A"},
    {"HS_RESP",
     "E2675DD574ED7789310B3D2E7681F3790B466C773B1521FECF36577958371EA52F"
     "43FA259CC20FB35B47D6EBDD5D13750C"},
    {"k_i2r",
     "091C8EE82864E700FB048AD9EFFAA694D0C929B4ADDCBA3A2101811F050539AB"},
    {"k_r2i",
     "9849BAC0F7D1BB53774086DC7F58466AE154AEC3156114E569BD8DEDA62B2D88"},
    {"pt_h2b", "686F73742D3E627269646765"},
    {"DATA_h2b_1", "E00100000000000000470670EBAEE0D0EB3F8FDE0D7B029CCC10271FE89"
                   "5290D55468DC36A"},
    {"pt_b2h", "6272696467652D3E686F7374"},
    {"DATA_b2h_1", "E00100000000000000FC9C930BA8B4AC98EAD4931797DF4AC93F0E8F912"
                   "D5754272A118910"},
};

static size_t vec(const char *label, uint8_t *out, size_t out_max) {
  for (const Vector &v : VECTORS) {
    if (strcmp(v.label, label) == 0) {
      return unhex(out, out_max, v.hex);
    }
  }
  printf("no such vector: %s\n", label);
  exit(2);
}

/* ── Known-answer tests for the libsodium primitives ─────────────────── */

/* RFC 7748 section 6.1 */
static void kat_x25519() {
  uint8_t a_sk[32], a_pk[32], b_sk[32], b_pk[32], k[32], got[32];

  unhex(a_sk, 32,
        "77076d0a7318a57d3c16c17251b26645df4c2f87ebc0992ab177fba51db92c2a");
  unhex(a_pk, 32,
        "8520f0098930a754748b7ddcb43ef75a0dbf3a0d26381af4eba4a98eaa9b4e6a");
  unhex(b_sk, 32,
        "5dab087e624a8a4b79e17f8b83800ee66f3bb1292618b6fd1c2f8b27ff88e0eb");
  unhex(b_pk, 32,
        "de9edb7d7b7dc1b4d35b61c2ece435373f8343c85b78674dadfc7e146f882b4f");
  unhex(k, 32,
        "4a5d9d5ba4ce2de1728e3bf480350f25e07e21c947d19e3376f09b3c1e161742");

  CHECK(crypto_scalarmult_curve25519_base(got, a_sk) == 0);
  CHECK_MEM(got, a_pk, 32);
  CHECK(crypto_scalarmult_curve25519_base(got, b_sk) == 0);
  CHECK_MEM(got, b_pk, 32);
  CHECK(crypto_scalarmult_curve25519(got, a_sk, b_pk) == 0);
  CHECK_MEM(got, k, 32);
  CHECK(crypto_scalarmult_curve25519(got, b_sk, a_pk) == 0);
  CHECK_MEM(got, k, 32);

  /* keygen is exactly X25519(seed, 9) with the seed kept verbatim. */
  nuki_seclink_static_t s;
  nuki_seclink_keygen(&s, a_sk);
  CHECK_MEM(s.sk, a_sk, 32);
  CHECK_MEM(s.pk, a_pk, 32);
}

/* BLAKE2b: RFC 7693 Appendix A ("abc", 512-bit) and the empty 256-bit digest.
 */
static void kat_blake2b() {
  uint8_t want[64], got[64];

  unhex(want, 32,
        "0e5751c026e543b2e8ab2eb06099daa1d1e5df47778f7787faab45cdf12fe3a8");
  CHECK(crypto_generichash(got, 32, nullptr, 0, nullptr, 0) == 0);
  CHECK_MEM(got, want, 32);

  unhex(want, 64,
        "ba80a53f981c4d0d6a2797b69f12f6e94c212f14685ac4b74b12bb6fdbffa2d1"
        "7d87c5392aab792dc252d5de4533cc9518d38aa8dbf1925ab92386edd4009923");
  CHECK(crypto_generichash(got, 64, (const uint8_t *)"abc", 3, nullptr, 0) ==
        0);
  CHECK_MEM(got, want, 64);

  /* Keyed with an empty key must equal the unkeyed hash (mapping pin). */
  unhex(want, 32,
        "0e5751c026e543b2e8ab2eb06099daa1d1e5df47778f7787faab45cdf12fe3a8");
  CHECK(crypto_generichash(got, 32, nullptr, 0, nullptr, 0) == 0);
  CHECK_MEM(got, want, 32);

  /* Keyed BLAKE2b-256 with a 32-byte key: consistent with the streaming API,
   * which is the textbook "key block first" construction Monocypher uses. */
  uint8_t key[32];
  for (size_t i = 0; i < 32; i++) {
    key[i] = (uint8_t)i;
  }
  uint8_t one_shot[32], streamed[32];
  crypto_generichash(one_shot, 32, (const uint8_t *)"i2r", 3, key, 32);
  crypto_generichash_state st;
  crypto_generichash_init(&st, key, 32, 32);
  crypto_generichash_update(&st, (const uint8_t *)"i2", 2);
  crypto_generichash_update(&st, (const uint8_t *)"r", 1);
  crypto_generichash_final(&st, streamed, 32);
  CHECK_MEM(one_shot, streamed, 32);
}

/* draft-irtf-cfrg-xchacha-03 A.3.1 */
static void kat_xchacha20poly1305() {
  static const char *PT =
      "Ladies and Gentlemen of the class of '99: If I could offer you "
      "only one tip for the future, sunscreen would be it.";
  uint8_t key[32], nonce[24], aad[12], want_ct[114], want_tag[16];
  uint8_t ct[114], tag[16], pt[114];
  unsigned long long tag_len = 0;

  for (size_t i = 0; i < 32; i++) {
    key[i] = (uint8_t)(0x80 + i);
  }
  for (size_t i = 0; i < 24; i++) {
    nonce[i] = (uint8_t)(0x40 + i);
  }
  unhex(aad, 12, "50515253c0c1c2c3c4c5c6c7");
  CHECK(strlen(PT) == 114);
  CHECK(unhex(want_ct, sizeof(want_ct),
              "bd6d179d3e83d43b9576579493c0e939572a1700252bfaccbed2902c21396cbb"
              "731c7f1b0b4aa6440bf3a82f4eda7e39ae64c6708c54c216cb96b72e1213b452"
              "2f8c9ba40db5d945b11b69b982c1bb9e3f3fac2bc369488f76b2383565d3fff9"
              "21f9664c97637da9768812f615c68b13b52e") == 114);
  unhex(want_tag, 16, "c0875924c1c7987947deafd8780acf49");

  CHECK(crypto_aead_xchacha20poly1305_ietf_encrypt_detached(
            ct, tag, &tag_len, (const uint8_t *)PT, 114, aad, sizeof(aad),
            nullptr, nonce, key) == 0);
  CHECK(tag_len == 16);
  CHECK_MEM(ct, want_ct, 114);
  CHECK_MEM(tag, want_tag, 16);
  CHECK(crypto_aead_xchacha20poly1305_ietf_decrypt_detached(
            pt, nullptr, want_ct, 114, want_tag, aad, sizeof(aad), nonce,
            key) == 0);
  CHECK_MEM(pt, (const uint8_t *)PT, 114);
}

/* ── Transcript replay: the ESP32 as initiator ───────────────────────── */

static void test_transcript_initiator() {
  uint8_t host_seed[32], host_eph_seed[32], bridge_pk[32];
  uint8_t want[64], got[64], out[64];
  size_t n;

  vec("host_seed", host_seed, 32);
  vec("host_eph_seed", host_eph_seed, 32);
  vec("bridge_pk", bridge_pk, 32);

  /* Static key from the seed: pins keygen. */
  nuki_seclink_static_t hs;
  nuki_seclink_keygen(&hs, host_seed);
  vec("host_pk", want, 32);
  CHECK_MEM(hs.pk, want, 32);

  nuki_seclink_ctx_t host;
  nuki_seclink_init(&host, NUKI_SECLINK_INITIATOR, &hs, nullptr);
  CHECK(nuki_seclink_get_state(&host) == NUKI_SECLINK_UNPAIRED);
  CHECK(!nuki_seclink_ready(&host));

  /* Our PAIR message must be byte-identical to the transcript. */
  CHECK(nuki_seclink_build_pair_msg(&host, got, 33) == 33);
  n = vec("PAIR_host", want, sizeof(want));
  CHECK(n == 33);
  CHECK_MEM(got, want, 33);

  /* Store the bridge's static key from ITS pair message (TOFU). */
  n = vec("PAIR_bridge", want, sizeof(want));
  CHECK(n == 33);
  CHECK(want[0] == NUKI_SECLINK_TYPE_PAIR);
  CHECK(nuki_seclink_is_sec_frame(want[0]));
  CHECK_MEM(want + 1, bridge_pk, 32);
  CHECK(nuki_seclink_set_peer(&host, want + 1) == NUKI_SECLINK_OK);
  CHECK(nuki_seclink_get_state(&host) == NUKI_SECLINK_PAIRED);

  /* HS_INIT from the pinned ephemeral seed. */
  CHECK(nuki_seclink_handshake_init(&host, host_eph_seed, got, sizeof(got)) ==
        33);
  CHECK(nuki_seclink_get_state(&host) == NUKI_SECLINK_HS_SENT);
  n = vec("HS_INIT", want, sizeof(want));
  CHECK(n == 33);
  CHECK_MEM(got, want, 33);
  vec("host_eph_pk", want, 32);
  CHECK_MEM(host.eph_pk, want, 32);

  /* The bridge's HS_RESP from the transcript must verify ... */
  n = vec("HS_RESP", want, sizeof(want));
  CHECK(n == 49);
  CHECK(nuki_seclink_handshake_finish(&host, want, n) == NUKI_SECLINK_OK);
  CHECK(nuki_seclink_get_state(&host) == NUKI_SECLINK_READY);
  CHECK(nuki_seclink_ready(&host));

  /* ... and yield the pinned directional keys. */
  vec("k_i2r", want, 32);
  CHECK_MEM(host.k_send, want, 32);
  vec("k_r2i", want, 32);
  CHECK_MEM(host.k_recv, want, 32);
  static const uint8_t zero32[32] = {0};
  CHECK_MEM(host.eph_sk, zero32, 32); /* ephemeral secret wiped */
  CHECK(host.ctr_send == 0);
  CHECK(host.ctr_recv == 0);

  /* First sealed frame host -> bridge, byte for byte. */
  uint8_t pt[32];
  size_t pt_len = vec("pt_h2b", pt, sizeof(pt));
  CHECK(pt_len == 12);
  int w = nuki_seclink_seal(&host, pt, pt_len, got, sizeof(got));
  CHECK(w == (int)(pt_len + NUKI_SECLINK_OVERHEAD));
  n = vec("DATA_h2b_1", want, sizeof(want));
  CHECK(n == (size_t)w);
  CHECK_MEM(got, want, n);
  CHECK(host.ctr_send == 1);

  /* First bridge -> host frame from the transcript opens. */
  n = vec("DATA_b2h_1", want, sizeof(want));
  memset(out, 0xAA, sizeof(out));
  int r = nuki_seclink_open(&host, want, n, out, sizeof(out));
  CHECK(r == 12);
  vec("pt_b2h", pt, sizeof(pt));
  CHECK_MEM(out, pt, 12);
  CHECK(host.ctr_recv == 1);

  /* Replaying the bridge's frame is refused without touching the counter. */
  CHECK(nuki_seclink_open(&host, want, n, out, sizeof(out)) ==
        NUKI_SECLINK_EREPLAY);
  CHECK(host.ctr_recv == 1);
}

/* ── Transcript replay: both roles in-process (DH slot ordering) ─────── */

static void test_transcript_both_roles() {
  uint8_t host_seed[32], bridge_seed[32], host_eph[32], bridge_eph[32];
  uint8_t init[33], resp[49], want[64], frame[64], out[64], pt[16];
  size_t n;

  vec("host_seed", host_seed, 32);
  vec("bridge_seed", bridge_seed, 32);
  vec("host_eph_seed", host_eph, 32);
  vec("bridge_eph_seed", bridge_eph, 32);

  nuki_seclink_static_t hs, bs;
  nuki_seclink_keygen(&hs, host_seed);
  nuki_seclink_keygen(&bs, bridge_seed);
  vec("bridge_pk", want, 32);
  CHECK_MEM(bs.pk, want, 32);

  nuki_seclink_ctx_t host, bridge;
  nuki_seclink_init(&host, NUKI_SECLINK_INITIATOR, &hs, bs.pk);
  nuki_seclink_init(&bridge, NUKI_SECLINK_RESPONDER, &bs, hs.pk);
  CHECK(nuki_seclink_get_state(&host) == NUKI_SECLINK_PAIRED);
  CHECK(nuki_seclink_get_state(&bridge) == NUKI_SECLINK_PAIRED);

  CHECK(nuki_seclink_handshake_init(&host, host_eph, init, sizeof(init)) == 33);
  CHECK(nuki_seclink_handshake_respond(&bridge, bridge_eph, init, 33, resp,
                                       sizeof(resp)) == 49);
  CHECK(nuki_seclink_get_state(&bridge) == NUKI_SECLINK_READY);
  /* The responder path reproduces the bridge's HS_RESP exactly. */
  n = vec("HS_RESP", want, sizeof(want));
  CHECK(n == 49);
  CHECK_MEM(resp, want, 49);
  vec("bridge_eph_pk", want, 32);
  CHECK_MEM(bridge.eph_pk, want, 32);

  CHECK(nuki_seclink_handshake_finish(&host, resp, 49) == NUKI_SECLINK_OK);
  CHECK_MEM(host.k_send, bridge.k_recv, 32);
  CHECK_MEM(host.k_recv, bridge.k_send, 32);
  CHECK(memcmp(host.k_send, host.k_recv, 32) != 0);
  vec("k_i2r", want, 32);
  CHECK_MEM(bridge.k_recv, want, 32);
  vec("k_r2i", want, 32);
  CHECK_MEM(bridge.k_send, want, 32);

  /* Bridge -> host first frame reproduced from the responder side. */
  n = vec("pt_b2h", pt, sizeof(pt));
  int w = nuki_seclink_seal(&bridge, pt, n, frame, sizeof(frame));
  CHECK(w == 37);
  n = vec("DATA_b2h_1", want, sizeof(want));
  CHECK(n == (size_t)w);
  CHECK_MEM(frame, want, n);
  CHECK(nuki_seclink_open(&host, frame, (size_t)w, out, sizeof(out)) == 12);
  CHECK_MEM(out, pt, 12);

  /* Host -> bridge first frame opens on the responder. */
  n = vec("pt_h2b", pt, sizeof(pt));
  w = nuki_seclink_seal(&host, pt, n, frame, sizeof(frame));
  n = vec("DATA_h2b_1", want, sizeof(want));
  CHECK_MEM(frame, want, n);
  CHECK(nuki_seclink_open(&bridge, frame, (size_t)w, out, sizeof(out)) == 12);
  CHECK_MEM(out, pt, 12);
}

/* ── Behaviour: replay, tamper, impostor, state machine ──────────────── */

struct Pair {
  nuki_seclink_ctx_t host;
  nuki_seclink_ctx_t bridge;
};

static void ramp(uint8_t *out, uint8_t start) {
  for (size_t i = 0; i < 32; i++) {
    out[i] = (uint8_t)(start + i);
  }
}

static void make_pair(Pair *p, uint8_t host_start, uint8_t bridge_start) {
  uint8_t hseed[32], bseed[32];
  nuki_seclink_static_t hs, bs;
  ramp(hseed, host_start);
  ramp(bseed, bridge_start);
  nuki_seclink_keygen(&hs, hseed);
  nuki_seclink_keygen(&bs, bseed);
  nuki_seclink_init(&p->host, NUKI_SECLINK_INITIATOR, &hs, bs.pk);
  nuki_seclink_init(&p->bridge, NUKI_SECLINK_RESPONDER, &bs, hs.pk);
}

static void do_handshake(Pair *p, uint8_t h_eph_start, uint8_t b_eph_start) {
  uint8_t heph[32], beph[32], init[33], resp[49];
  ramp(heph, h_eph_start);
  ramp(beph, b_eph_start);
  CHECK(nuki_seclink_handshake_init(&p->host, heph, init, 33) == 33);
  CHECK(nuki_seclink_handshake_respond(&p->bridge, beph, init, 33, resp, 49) ==
        49);
  CHECK(nuki_seclink_handshake_finish(&p->host, resp, 49) == NUKI_SECLINK_OK);
  CHECK(nuki_seclink_ready(&p->host));
  CHECK(nuki_seclink_ready(&p->bridge));
}

static void roundtrip(nuki_seclink_ctx_t *tx, nuki_seclink_ctx_t *rx, size_t n,
                      uint64_t expect_ctr) {
  uint8_t pt[256], wire[256 + NUKI_SECLINK_OVERHEAD], got[256];
  for (size_t i = 0; i < n; i++) {
    pt[i] = (uint8_t)(i * 31U + n);
  }
  int w = nuki_seclink_seal(tx, pt, n, wire, sizeof(wire));
  CHECK(w == (int)(n + NUKI_SECLINK_OVERHEAD));
  CHECK(wire[0] == NUKI_SECLINK_TYPE_DATA);
  CHECK(tx->ctr_send == expect_ctr);
  if (n > 0) {
    CHECK(memcmp(wire + NUKI_SECLINK_OVERHEAD, pt, n) != 0);
  }
  memset(got, 0xAA, sizeof(got));
  int r = nuki_seclink_open(rx, wire, (size_t)w, got, sizeof(got));
  CHECK(r == (int)n);
  CHECK_MEM(got, pt, n);
  CHECK(rx->ctr_recv == expect_ctr);
}

static void test_roundtrips() {
  Pair p;
  make_pair(&p, 0x00, 0x20);
  do_handshake(&p, 0x40, 0x60);

  static const size_t lens[] = {0, 1, 5, 123, 200};
  uint64_t c = 0;
  for (size_t len : lens) {
    roundtrip(&p.host, &p.bridge, len, ++c);
  }
  c = 0;
  for (size_t len : lens) {
    roundtrip(&p.bridge, &p.host, len, ++c);
  }

  /* Exact-size output buffer is accepted, one byte short is not. */
  uint8_t wire[7 + NUKI_SECLINK_OVERHEAD], out[7];
  CHECK(nuki_seclink_seal(&p.host, (const uint8_t *)"host->b", 7, wire,
                          sizeof(wire) - 1) == NUKI_SECLINK_EINVAL);
  CHECK(nuki_seclink_seal(&p.host, (const uint8_t *)"host->b", 7, wire,
                          sizeof(wire)) == (int)sizeof(wire));
  CHECK(nuki_seclink_open(&p.bridge, wire, sizeof(wire), out, 6) ==
        NUKI_SECLINK_EINVAL);
  CHECK(nuki_seclink_open(&p.bridge, wire, sizeof(wire), out, 7) == 7);
  CHECK_MEM(out, (const uint8_t *)"host->b", 7);

  /* A v2 command body [TYPE][SEQ][DATA] survives as an opaque inner frame. */
  static const uint8_t cmd[] = {0x01, 0x2A, 0x00};
  uint8_t sealed[64], opened[8];
  int w = nuki_seclink_seal(&p.host, cmd, sizeof(cmd), sealed, sizeof(sealed));
  CHECK(w == 3 + 25);
  CHECK(nuki_seclink_is_sec_frame(sealed[0]));
  CHECK(nuki_seclink_open(&p.bridge, sealed, (size_t)w, opened,
                          sizeof(opened)) == 3);
  CHECK_MEM(opened, cmd, 3);
}

static void test_replay_and_tamper() {
  Pair p;
  make_pair(&p, 0x00, 0x20);
  do_handshake(&p, 0x40, 0x60);

  uint8_t f1[64], f2[64], f3[64], out[64];
  int n1 = nuki_seclink_seal(&p.host, (const uint8_t *)"one", 3, f1, 64);
  int n2 = nuki_seclink_seal(&p.host, (const uint8_t *)"two", 3, f2, 64);
  int n3 = nuki_seclink_seal(&p.host, (const uint8_t *)"three", 5, f3, 64);
  CHECK(n1 == 28 && n2 == 28 && n3 == 30);

  CHECK(nuki_seclink_open(&p.bridge, f1, (size_t)n1, out, 64) == 3);
  CHECK(nuki_seclink_open(&p.bridge, f1, (size_t)n1, out, 64) ==
        NUKI_SECLINK_EREPLAY);
  /* 3 before 2: the gap is fine, the late frame is dead. */
  CHECK(nuki_seclink_open(&p.bridge, f3, (size_t)n3, out, 64) == 5);
  CHECK(nuki_seclink_open(&p.bridge, f2, (size_t)n2, out, 64) ==
        NUKI_SECLINK_EREPLAY);
  CHECK(p.bridge.ctr_recv == 3);

  /* Tampering: ciphertext, tag, header (higher counter) and truncation. */
  uint8_t frame[64], bad[64];
  int n = nuki_seclink_seal(&p.bridge, (const uint8_t *)"bridge->host", 12,
                            frame, 64);
  CHECK(n == 37);
  const uint64_t before = p.host.ctr_recv;

  memcpy(bad, frame, (size_t)n);
  bad[NUKI_SECLINK_OVERHEAD + 3] ^= 0x01;
  CHECK(nuki_seclink_open(&p.host, bad, (size_t)n, out, 64) ==
        NUKI_SECLINK_EAUTH);
  memcpy(bad, frame, (size_t)n);
  bad[NUKI_SECLINK_HDR_LEN + 15] ^= 0x80;
  CHECK(nuki_seclink_open(&p.host, bad, (size_t)n, out, 64) ==
        NUKI_SECLINK_EAUTH);
  memcpy(bad, frame, (size_t)n);
  bad[NUKI_SECLINK_HDR_LEN - 1] ^= 0x40;
  CHECK(nuki_seclink_open(&p.host, bad, (size_t)n, out, 64) ==
        NUKI_SECLINK_EAUTH);
  CHECK(nuki_seclink_open(&p.host, frame, NUKI_SECLINK_OVERHEAD - 1, out, 64) ==
        NUKI_SECLINK_EINVAL);
  CHECK(p.host.ctr_recv == before);
  /* The untouched frame still opens: nothing above consumed the counter. */
  CHECK(nuki_seclink_open(&p.host, frame, (size_t)n, out, 64) == 12);
  CHECK_MEM(out, (const uint8_t *)"bridge->host", 12);
  CHECK(p.host.ctr_recv == before + 1);
}

static void test_impostor_and_low_order() {
  Pair real;
  make_pair(&real, 0x00, 0x20);

  /* An impostor host knows the bridge's public key but not the real host's sk.
   */
  uint8_t imp_seed[32], heph[32], beph[32], init[33], resp[49], frame[64],
      out[64];
  ramp(imp_seed, 0xC0);
  ramp(heph, 0x40);
  ramp(beph, 0x60);
  nuki_seclink_static_t imp_static;
  nuki_seclink_keygen(&imp_static, imp_seed);
  nuki_seclink_ctx_t imp;
  nuki_seclink_init(&imp, NUKI_SECLINK_INITIATOR, &imp_static,
                    real.bridge.self.pk);

  CHECK(nuki_seclink_handshake_init(&imp, heph, init, 33) == 33);
  CHECK(nuki_seclink_handshake_respond(&real.bridge, beph, init, 33, resp,
                                       49) == 49);
  CHECK(nuki_seclink_handshake_finish(&imp, resp, 49) == NUKI_SECLINK_EAUTH);
  CHECK(nuki_seclink_get_state(&imp) == NUKI_SECLINK_PAIRED);
  static const uint8_t zero32[32] = {0};
  CHECK_MEM(imp.k_send, zero32, 32);
  CHECK(nuki_seclink_seal(&imp, (const uint8_t *)"x", 1, frame, 64) ==
        NUKI_SECLINK_ESTATE);

  /* Forced READY with guessed keys: nothing opens on the bridge. */
  imp.state = NUKI_SECLINK_READY;
  memset(imp.k_send, 0x55, 32);
  int n = nuki_seclink_seal(&imp, (const uint8_t *)"hello", 5, frame, 64);
  CHECK(n == 30);
  CHECK(nuki_seclink_open(&real.bridge, frame, (size_t)n, out, 64) ==
        NUKI_SECLINK_EAUTH);
  CHECK(real.bridge.ctr_recv == 0);

  /* The next genuine HS_INIT replaces the dead session. */
  do_handshake(&real, 0x80, 0xA0);
  roundtrip(&real.host, &real.bridge, 9, 1);
  roundtrip(&real.bridge, &real.host, 9, 1);

  /* Low-order points: rejected at pairing and in both handshake halves. */
  CHECK(nuki_seclink_set_peer(&imp, zero32) == NUKI_SECLINK_EINVAL);
  uint8_t bad_init[33] = {NUKI_SECLINK_TYPE_HS_INIT};
  CHECK(nuki_seclink_handshake_respond(&real.bridge, beph, bad_init, 33, resp,
                                       49) == NUKI_SECLINK_EAUTH);
  CHECK(nuki_seclink_get_state(&real.bridge) == NUKI_SECLINK_PAIRED);
  CHECK_MEM(real.bridge.k_send, zero32, 32);
  CHECK(nuki_seclink_handshake_init(&real.host, heph, init, 33) == 33);
  uint8_t bad_resp[49] = {NUKI_SECLINK_TYPE_HS_RESP};
  CHECK(nuki_seclink_handshake_finish(&real.host, bad_resp, 49) ==
        NUKI_SECLINK_EAUTH);
  CHECK(nuki_seclink_get_state(&real.host) == NUKI_SECLINK_PAIRED);
}

static void test_state_machine() {
  Pair p;
  make_pair(&p, 0x00, 0x20);
  uint8_t heph[32], init[33], resp[49], buf[64], out[64];
  ramp(heph, 0x40);

  /* Not READY: no sealing, no opening. */
  CHECK(nuki_seclink_seal(&p.host, (const uint8_t *)"x", 1, buf, 64) ==
        NUKI_SECLINK_ESTATE);
  memset(buf, 0, sizeof(buf));
  buf[0] = NUKI_SECLINK_TYPE_DATA;
  CHECK(nuki_seclink_open(&p.host, buf, 33, out, 64) == NUKI_SECLINK_ESTATE);

  /* finish without init; wrong roles. */
  memset(resp, 0, sizeof(resp));
  resp[0] = NUKI_SECLINK_TYPE_HS_RESP;
  CHECK(nuki_seclink_handshake_finish(&p.host, resp, 49) ==
        NUKI_SECLINK_ESTATE);
  CHECK(nuki_seclink_handshake_init(&p.bridge, heph, init, 33) ==
        NUKI_SECLINK_ESTATE);

  /* HS_SENT: malformed replies leave the state alone, keep waiting. */
  CHECK(nuki_seclink_handshake_init(&p.host, heph, init, 33) == 33);
  CHECK(nuki_seclink_get_state(&p.host) == NUKI_SECLINK_HS_SENT);
  buf[0] = NUKI_SECLINK_TYPE_PAIR;
  CHECK(nuki_seclink_handshake_finish(&p.host, buf, 49) == NUKI_SECLINK_ETYPE);
  CHECK(nuki_seclink_get_state(&p.host) == NUKI_SECLINK_HS_SENT);
  CHECK(nuki_seclink_handshake_finish(&p.host, resp, 48) ==
        NUKI_SECLINK_EINVAL);
  CHECK(nuki_seclink_get_state(&p.host) == NUKI_SECLINK_HS_SENT);
  /* A second HS_INIT from HS_SENT (lost HS_RESP) is allowed. */
  CHECK(nuki_seclink_handshake_init(&p.host, heph, init, 33) == 33);
  CHECK(nuki_seclink_get_state(&p.host) == NUKI_SECLINK_HS_SENT);

  /* Unpaired initiator cannot start a handshake. */
  nuki_seclink_ctx_t un;
  nuki_seclink_init(&un, NUKI_SECLINK_INITIATOR, &p.host.self, nullptr);
  CHECK(nuki_seclink_handshake_init(&un, heph, init, 33) ==
        NUKI_SECLINK_ENOPEER);
  CHECK(nuki_seclink_set_peer(&un, nullptr) == NUKI_SECLINK_EINVAL);

  /* Buffers too small. */
  CHECK(nuki_seclink_build_pair_msg(&p.host, buf, 32) == NUKI_SECLINK_EINVAL);
  CHECK(nuki_seclink_handshake_init(&p.host, heph, init, 32) ==
        NUKI_SECLINK_EINVAL);

  /* Classifier. */
  CHECK(nuki_seclink_is_sec_frame(0xE0));
  CHECK(nuki_seclink_is_sec_frame(0xE3));
  CHECK(!nuki_seclink_is_sec_frame(0xDF));
  CHECK(!nuki_seclink_is_sec_frame(0xE4));
  CHECK(!nuki_seclink_is_sec_frame(0x7D));
  CHECK(!nuki_seclink_is_sec_frame(0x90));

  /* Open: non-DATA types and short frames. */
  do_handshake(&p, 0x40, 0x60);
  memset(buf, 0, sizeof(buf));
  buf[0] = NUKI_SECLINK_TYPE_HS_RESP;
  CHECK(nuki_seclink_open(&p.host, buf, 49, out, 64) == NUKI_SECLINK_ETYPE);
  buf[0] = NUKI_SECLINK_TYPE_DATA;
  CHECK(nuki_seclink_open(&p.host, buf, 24, out, 64) == NUKI_SECLINK_EINVAL);
  CHECK(nuki_seclink_open(&p.host, nullptr, 33, out, 64) ==
        NUKI_SECLINK_EINVAL);
  CHECK(p.host.ctr_recv == 0);

  /* Counter exhaustion: refuse rather than reuse a nonce. */
  p.host.ctr_send = UINT64_MAX;
  CHECK(nuki_seclink_seal(&p.host, (const uint8_t *)"x", 1, buf, 64) ==
        NUKI_SECLINK_ESTATE);
  CHECK(p.host.ctr_send == UINT64_MAX);

  /* end_session keeps the keys; the same seeds give the same session keys;
   * a fresh handshake straight from READY resyncs. */
  uint8_t k1[32];
  p.host.ctr_send = 5;
  memcpy(k1, p.host.k_send, 32);
  nuki_seclink_end_session(&p.host);
  nuki_seclink_end_session(&p.bridge);
  CHECK(nuki_seclink_get_state(&p.host) == NUKI_SECLINK_PAIRED);
  static const uint8_t zero32[32] = {0};
  CHECK_MEM(p.host.k_send, zero32, 32);
  CHECK(p.host.ctr_send == 0);
  CHECK(memcmp(p.host.self.sk, zero32, 32) != 0);
  CHECK(memcmp(p.host.peer_pk, zero32, 32) != 0);
  do_handshake(&p, 0x80, 0xA0);
  CHECK(memcmp(p.host.k_send, k1, 32) != 0);
  roundtrip(&p.host, &p.bridge, 4, 1);
  do_handshake(&p, 0x40, 0x60);
  CHECK_MEM(p.host.k_send, k1, 32);
  do_handshake(&p, 0x80, 0xA0);
  roundtrip(&p.bridge, &p.host, 1, 1);

  /* wipe: everything gone, role kept. */
  nuki_seclink_wipe(&p.host);
  CHECK(nuki_seclink_get_state(&p.host) == NUKI_SECLINK_UNPAIRED);
  CHECK(p.host.role == NUKI_SECLINK_INITIATOR);
  CHECK_MEM(p.host.self.sk, zero32, 32);
  CHECK_MEM(p.host.peer_pk, zero32, 32);
  CHECK(strcmp(nuki_seclink_state_name(NUKI_SECLINK_READY), "ready") == 0);

  /* Host-contract constants shared with the bridge. */
  CHECK(NUKI_UART_CAP_SEC_LINK_SUPPORTED == 0x0020);
  CHECK(NUKI_UART_CAP_SEC_REQUIRED == 0x0040);
  CHECK(NUKI_UART_CMD_PAIR_WINDOW == 0x77);
  CHECK(NUKI_UART_CMD_UNPAIR_HOST == 0x78);
  CHECK(NUKI_UART_ERR_SECURE_REQUIRED == 0x08);
}

/* ── Optional: cross-check the bridge's vectors file against the pins ── */

static void test_vectors_file(const char *path) {
  FILE *f = fopen(path, "r");
  if (f == nullptr) {
    printf("FAIL: cannot open %s\n", path);
    failures++;
    return;
  }
  char line[512];
  size_t matched = 0;
  while (fgets(line, sizeof(line), f) != nullptr) {
    if (line[0] == '#' || line[0] == '\n') {
      continue;
    }
    char label[64], hex[400];
    if (sscanf(line, "%63s %399s", label, hex) != 2) {
      continue;
    }
    for (const Vector &v : VECTORS) {
      if (strcmp(v.label, label) == 0) {
        uint8_t a[128], b[128];
        size_t na = unhex(a, sizeof(a), hex);
        size_t nb = unhex(b, sizeof(b), v.hex);
        CHECK(na == nb);
        if (na == nb) {
          CHECK_MEM(a, b, na);
        }
        matched++;
      }
    }
  }
  fclose(f);
  CHECK(matched == sizeof(VECTORS) / sizeof(VECTORS[0]));
  printf("vectors file %s: %u labels cross-checked\n", path, (unsigned)matched);
}

int main() {
  if (!nuki_seclink_crypto_init()) {
    printf("FAIL: sodium_init\n");
    return 1;
  }
  printf("libsodium %s\n", sodium_version_string());

  kat_x25519();
  kat_blake2b();
  kat_xchacha20poly1305();
  test_transcript_initiator();
  test_transcript_both_roles();
  test_roundtrips();
  test_replay_and_tamper();
  test_impostor_and_low_order();
  test_state_machine();

  const char *vectors = getenv("SEC_LINK_VECTORS");
  if (vectors != nullptr && vectors[0] != '\0') {
    test_vectors_file(vectors);
  }

  if (failures == 0) {
    printf("test_seclink_host: all %d checks passed\n", checks);
    return 0;
  }
  printf("test_seclink_host: %d of %d checks FAILED\n", failures, checks);
  return 1;
}
